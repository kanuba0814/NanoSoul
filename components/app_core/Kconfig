## components/app_core/Kconfig
```kconfig
menu "app_core"

config NANOSOUL_APP_CORE_ENABLE
    bool "Enable app_core"
    default y

endmenu
```

## components/audio_core/Kconfig
```kconfig
menu "audio_core"

config NANOSOUL_AUDIO_CORE_ENABLE
    bool "Enable audio_core"
    default y

endmenu
```

## components/bsp_board/Kconfig
```kconfig
menu "bsp_board"

config NANOSOUL_BSP_BOARD_ENABLE
    bool "Enable bsp_board"
    default y

endmenu
```

## components/diag_core/Kconfig
```kconfig
menu "diag_core"

config NANOSOUL_DIAG_CORE_ENABLE
    bool "Enable diag_core"
    default y

endmenu
```

## components/hal_mock/Kconfig
```kconfig
menu "hal_mock"

config NANOSOUL_HAL_MOCK_ENABLE
    bool "Enable hal_mock adapters"
    default n

endmenu
```

## components/input_core/Kconfig
```kconfig
menu "input_core"

config NANOSOUL_INPUT_CORE_ENABLE
    bool "Enable input_core"
    default y

endmenu
```

## components/log_core/Kconfig
```kconfig
menu "log_core"

config NANOSOUL_LOG_CORE_ENABLE
    bool "Enable log_core"
    default y

endmenu
```

## components/motion_core/Kconfig
```kconfig
menu "motion_core"

config NANOSOUL_MOTION_CORE_ENABLE
    bool "Enable motion_core abstract boundary"
    default n

endmenu
```

## components/net_core/Kconfig
```kconfig
menu "net_core"

config NANOSOUL_NET_CORE_ENABLE
    bool "Enable net_core"
    default y

endmenu
```

## components/sense_core/Kconfig
```kconfig
menu "sense_core"

config NANOSOUL_SENSE_CORE_ENABLE
    bool "Enable sense_core"
    default y

endmenu
```

## components/soul_core/Kconfig
```kconfig
menu "soul_core"

config NANOSOUL_SOUL_CORE_ENABLE
    bool "Enable soul_core"
    default y

endmenu
```

## components/speech_core/Kconfig
```kconfig
menu "speech_core"

config NANOSOUL_SPEECH_CORE_ENABLE
    bool "Enable speech_core"
    default y

endmenu
```

## components/storage_core/Kconfig
```kconfig
menu "storage_core"

config NANOSOUL_STORAGE_CORE_ENABLE
    bool "Enable storage_core"
    default y

endmenu
```

## components/task_core/Kconfig
```kconfig
menu "task_core"

config NANOSOUL_TASK_CORE_ENABLE
    bool "Enable task_core"
    default y

endmenu
```

## components/ui_core/Kconfig
```kconfig
menu "ui_core"

config NANOSOUL_UI_CORE_ENABLE
    bool "Enable ui_core"
    default y

endmenu
```

## components/vision_core/Kconfig
```kconfig
menu "vision_core"

config NANOSOUL_VISION_CORE_ENABLE
    bool "Enable vision_core"
    default y

endmenu
```
